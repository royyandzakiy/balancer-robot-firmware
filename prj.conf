## CMakeLists.txt
```
# SPDX-License-Identifier: Apache-2.0

cmake_minimum_required(VERSION 3.20.0)
find_package(Zephyr REQUIRED HINTS $ENV{ZEPHYR_BASE})
project(cpp_synchronization)

target_sources(app 
	PRIVATE 
		src/main.cpp
)
```

## prj.conf
```kconfig
# General System Settings
CONFIG_SYSTEM_WORKQUEUE_STACK_SIZE=2048
CONFIG_MAIN_STACK_SIZE=2048
CONFIG_ISR_STACK_SIZE=2048

# Random number generator
CONFIG_TEST_RANDOM_GENERATOR=y
```

## cpp-overlay.conf
```kconfig
# C++ Language Support
CONFIG_CPP=y
CONFIG_STD_CPP2B=y
CONFIG_GLIBCXX_LIBCPP=y

# Memory Management for C++
# Note: C++ often requires a larger heap for 'new' and STL containers
CONFIG_HEAP_MEM_POOL_SIZE=8192

# Optional C++ Features (Uncomment if needed)
CONFIG_CPP_EXCEPTIONS=y
CONFIG_CPP_RTTI=y
CONFIG_NEWLIB_LIBC=y
```

## src/main.cpp
```c
// main.cpp
#include <array>
#include <chrono>
#include <concepts>
#include <cstdio>
#include <limits>
#include <numeric>
#include <ranges>
#include <span>
#include <string_view>
#include <tuple>
#include <variant>
#include <ranges>
#include <zephyr/kernel.h>
#include <zephyr/logging/log.h>
#include <zephyr/random/random.h>

LOG_MODULE_REGISTER(state_machine, LOG_LEVEL_INF);


using namespace std::chrono_literals;
using namespace std::string_view_literals;

extern "C" int main(void) {
	// ...

	return 0;
}
```
